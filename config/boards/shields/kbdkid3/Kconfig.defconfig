## config/boards/shields/kbdkid3/Kconfig.defconfig
```kconfig
# Copyright (c) 2023 Tubbles
# SPDX-License-Identifier: MIT

if SHIELD_KBDKID3_LEFT

config ZMK_KEYBOARD_NAME
    default "kbdkid3"

config ZMK_SPLIT_ROLE_CENTRAL
    default y

endif

if SHIELD_KBDKID3_LEFT || SHIELD_KBDKID3_RIGHT
config ZMK_SPLIT
    default y
endif
```

## config/boards/shields/kbdkid3/Kconfig.shield
```kconfig
# Copyright (c) 2023 Tubbles
# SPDX-License-Identifier: MIT

config SHIELD_KBDKID3_LEFT
    def_bool $(shields_list_contains,kbdkid3_left)

config SHIELD_KBDKID3_RIGHT
    def_bool $(shields_list_contains,kbdkid3_right)

config SHIELD_KBDKID3_DONGLE
    def_bool $(shields_list_contains,kbdkid3_dongle)
```
